## sdkconfig.defaults
```kconfig
# Rust often needs a bit of an extra main task stack size compared to C (the default is 3K)
CONFIG_ESP_MAIN_TASK_STACK_SIZE=32768

# Use this to set FreeRTOS kernel tick frequency to 1000 Hz (100 Hz by default).
# This allows to use 1 ms granularity for thread sleeps (10 ms by default).
CONFIG_FREERTOS_HZ=1000

# Ethernet support
CONFIG_ETH_ENABLED=y
CONFIG_ETH_USE_ESP32_EMAC=y

# RTL8201 PHY support
CONFIG_ETH_PHY_INTERFACE_RMII=y

# LWIP settings for networking
CONFIG_LWIP_DHCP_DOES_ARP_CHECK=n
CONFIG_LWIP_IPV4=y
CONFIG_LWIP_DNS_MAX_SERVERS=3
# Disable mDNS interception for .local domains so they resolve via regular DNS
CONFIG_LWIP_DNS_SUPPORT_MDNS_QUERIES=n

# HTTP server
CONFIG_HTTPD_MAX_REQ_HDR_LEN=1024

# Logging
CONFIG_LOG_DEFAULT_LEVEL_INFO=y
CONFIG_LOG_MAXIMUM_LEVEL_DEBUG=y
```
